/**
 * @cliArgs --device "CC3200" --package "Default" --part "Default"
 * @versions {"tool":"1.19.0+3426"}
 */
scripting.excludeFromBuild("pin_mux_config.c");
scripting.excludeFromBuild("pin_mux_config.h");
scripting.excludeFromBuild("rom_pin_mux_config.c");
scripting.excludeFromBuild("summary.csv");

/**
 * These are the peripherals and settings in this configuration
 */
const iGPIO1        = scripting.addPeripheral("GPIO");
iGPIO1.$name        = "MyGPIO1";
iGPIO1.GPIO00.$used = false;
iGPIO1.GPIO01.$used = false;
iGPIO1.GPIO02.$used = false;
iGPIO1.GPIO03.$used = false;
iGPIO1.GPIO04.$used = false;
iGPIO1.GPIO05.$used = false;
iGPIO1.GPIO06.$used = false;
iGPIO1.GPIO07.$used = false;
iGPIO1.GPIO08.io    = "output";
iGPIO1.GPIO09.io    = "output";
iGPIO1.GPIO10.$used = false;
iGPIO1.GPIO11.$used = false;
iGPIO1.GPIO12.io    = "output";
iGPIO1.GPIO13.$used = false;
iGPIO1.GPIO15.$used = false;
iGPIO1.GPIO16.$used = false;
iGPIO1.GPIO17.$used = false;
iGPIO1.GPIO22.$used = false;
iGPIO1.GPIO23.$used = false;
iGPIO1.GPIO24.$used = false;
iGPIO1.GPIO28.$used = false;
iGPIO1.GPIO29.$used = false;
iGPIO1.GPIO25.$used = false;
iGPIO1.GPIO30.$used = false;
iGPIO1.GPIO31.$used = false;
iGPIO1.GPIO32.$used = false;
const iSPI1         = scripting.addPeripheral("SPI");
iSPI1.$name         = "MySPI1";
iSPI1.$assign       = "SPI0";
const iUART1        = scripting.addPeripheral("UART");
iUART1.$name        = "MyUART2";
iUART1.RTS.$used    = false;
iUART1.CTS.$used    = false;
const iUART2        = scripting.addPeripheral("UART");
iUART2.$name        = "MyUART1";
iUART2.$assign      = "UART0";
iUART2.RTS.$used    = false;
iUART2.CTS.$used    = false;

/**
 * Pinmux solution for unlocked pins/peripherals. This ensures that minor changes to the automatic solver in a future
 * version of the tool will not impact the pinmux you originally saw.  These lines can be completely deleted in order to
 * re-solve from scratch.
 */
iGPIO1.$suggestSolution        = "GPIO";
iGPIO1.GPIO08.$suggestSolution = "GP08";
iGPIO1.GPIO09.$suggestSolution = "GP09";
iGPIO1.GPIO12.$suggestSolution = "GP12";
iGPIO1.GPIO14.$suggestSolution = "GP14";
iSPI1.CS.$suggestSolution      = "GP00";
iSPI1.CLK.$suggestSolution     = "GP31";
iSPI1.MISO.$suggestSolution    = "GP15";
iSPI1.MOSI.$suggestSolution    = "GP16";
iUART1.$suggestSolution        = "UART1";
iUART1.TX.$suggestSolution     = "GP03";
iUART1.RX.$suggestSolution     = "GP04";
iUART2.TX.$suggestSolution     = "GP01";
iUART2.RX.$suggestSolution     = "GP02";
